## CMakeLists.txt
```
cmake_minimum_required(VERSION 3.20.0)

find_package(Zephyr REQUIRED HINTS $ENV{ZEPHYR_BASE})
project(nRF840_zypher)

target_sources(app PRIVATE src/main.c)
```

## prj.conf
```kconfig
# Kernel
CONFIG_MAIN_STACK_SIZE=1024

# Logging
CONFIG_LOG=y
CONFIG_LOG_BACKEND_UART=y
CONFIG_LOG_DEFAULT_LEVEL=3
```

## src/main.c
```c
/*
 * SPDX-License-Identifier: GPL-3.0-or-later
 *
 * Hello World for nRF52832 using Zephyr RTOS.
 * Logs a greeting message once on boot, then sleeps.
 */

#include <zephyr/kernel.h>
#include <zephyr/logging/log.h>

LOG_MODULE_REGISTER(main, LOG_LEVEL_DBG);

int main(void)
{
	LOG_INF("Hello World from nRF52832!");

	while (1) {
		k_sleep(K_FOREVER);
	}

	return 0;
}
```
